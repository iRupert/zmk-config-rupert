## config/boards/shields/Kconfig.defconfig
```kconfig
if SHIELD_rupert_LEFT

config ZMK_KEYBOARD_NAME
    default "Rupert kbrd"

config ZMK_SPLIT_ROLE_CENTRAL
    default y

endif

if SHIELD_rupert_LEFT || SHIELD_rupert_RIGHT

config ZMK_SPLIT
    default y
endif
```

## config/boards/shields/Kconfig.shield
```kconfig
config SHIELD_rupert_LEFT
    def_bool $(shields_list_contains, rupert_left)

config SHIELD_rupert_RIGHT
    def_bool $(shields_list_contains, rupert_right)
```
